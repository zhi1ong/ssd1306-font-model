#include <Wire.h>
#include <mpr121.h>
#include "ASCII7x8.h"

#define iic_bus 0x3C
#define DC 44
#define RES 45

int currentLine = 0;

//发送命令到i2c总线
void send_cmd(unsigned char COM) {
  Wire.beginTransmission(iic_bus);
  Wire.write(0x00);
  Wire.write(COM);
  Wire.endTransmission();
}

//发送数据到i2c总线
void send_data(unsigned char DATA) {
  Wire.beginTransmission(iic_bus);
  Wire.write(0x40);
  Wire.write(DATA);
  Wire.endTransmission();
}

//初始化oled屏幕
void init_oled() {
  digitalWrite(RES,HIGH);   delay(100);
  digitalWrite(RES,LOW);    delay(100);
  digitalWrite(RES,HIGH);   delay(100);
  send_cmd(0XAE);//display off
  send_cmd(0X00);//set lower column address
  send_cmd(0X10);//set higher column address
  send_cmd(0X40);//set display start line
  send_cmd(0XB0);//set page address
  send_cmd(0X81);//set contract control
  send_cmd(0XCF);// VCC Generated by Internal DC/DC Circuit
  send_cmd(0XA1);//set segment remap  column address 127 is mapped to SEG0
  send_cmd(0XA6);//normal / reverse   normal display
  send_cmd(0XA8);//multiplex ratio
  send_cmd(0X3F);//1/64
  send_cmd(0XC8);//Com scan direction remapped mode. Scan from COM[N-1] to COM0
  send_cmd(0XD3);//set display offset
  send_cmd(0X00);
  send_cmd(0XD5);//set osc division
  send_cmd(0X80);
  send_cmd(0XD9);//set pre-charge period
  send_cmd(0X11);
  send_cmd(0XDa);//set COM pins
  send_cmd(0X12);
  send_cmd(0X8d);/*set charge pump enable*/
  send_cmd(0X14);
  send_cmd(0Xdb);//Set VcomH
  send_cmd(0X20);
  send_cmd(0XAF);//display ON
  clean_screen(0x00);
}

//清全屏
void clean_screen(unsigned char dat) {
  unsigned char i,j;
  send_cmd(0x00);//set lower column address
  send_cmd(0x10);//set higher column address
  send_cmd(0xB0);//set page address
  for(j=0;j<8;j++) {
    send_cmd(0xB0+j);//set page address
    send_cmd(0x00);//set lower column address
    send_cmd(0x10);//set higher column address
    for(i=0;i<128;i++) {
      send_data(dat);
    }
  }
}

//在指定位置写入一个char
//@param line : 行数
//@param page : 行数
void set_ascii7x8(byte line,byte bit,byte ascii) {
  send_cmd(0xB0+line);//set line address
  send_cmd(0x00+bit&0x0f);//set lower column address
  send_cmd(0x10+bit/16);//set higher column address
  for(byte i=0;i<7;i++)
  send_data(ASCII7x8[ascii*7+i]);
}

//打印一行，超出一行的不显示
//@param input : 输入
//@changeLine : 是否换行打印
void print2screen(String input, bool changeLine = true) {
  int input_Length = input.length();
  char tempchar[input_Length];
  if (changeLine == true)
  {
    if (currentLine >= 7)
      {
        input.toCharArray(tempchar, input_Length);
        for (int i = 0; i < input_Length; i++)
        {
          if (i <= 17)
          {
            set_ascii7x8(currentLine,i*7,tempchar[i]);
          } else {
            return;
          }
          //i <= 17 ? set_ascii7x8(currentLine,i*7,tempchar[i]) : break;
        }
      } else {
        input.toCharArray(tempchar, input_Length);
        for (int i = 0; i < input_Length; i++)
        {
          if (i <= 17)
          {
            set_ascii7x8(currentLine,i*7,tempchar[i]);
          } else {
            return;
          }
          //i <= 17 ? set_ascii7x8(currentLine,i*7,tempchar[i]) : break;
        }
        currentLine++;
      }
  } else {
    input.toCharArray(tempchar, input_Length);
    for (int i = 0; i < input_Length; i++)
    {
      if (i <= 17)
          {
            set_ascii7x8(currentLine,i*7,tempchar[i]);
          } else {
            return;
          }
      //i <= 17 ? set_ascii7x8(currentLine,i*7,tempchar[i]) : break;
    }
  }
}

void setup() {
  Serial.begin(115200);
  pinMode(RES,OUTPUT);//RES
  pinMode(DC,OUTPUT);//D/C#
  digitalWrite(DC,LOW);
  Wire.begin();
  init_oled();
  mpr121Init();
  analogReadResolution(12); 
  delay(50);
  
  print2screen("[+] I LIKE APPLE.");
  print2screen("[+] I LIKE BANANA.");
  print2screen("[+] I DO NOT LIKE APPLE.");
  print2screen("[+] I DO NOT LIKE BANANA.", false);

}

void loop() {

}